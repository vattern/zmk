## app/boards/arm/chockea/Kconfig.board
```kconfig
#
# Copyright (c) 2022 Thys de Wet
# SPDX-License-Identifier: MIT
#

config BOARD_CHOCKEA_LEFT
	bool "chockea_left"
	depends on SOC_NRF52840_QIAA

config BOARD_CHOCKEA_RIGHT
	bool "chockea_right"
	depends on SOC_NRF52840_QIAA
```

## app/boards/arm/chockea/Kconfig.defconfig
```kconfig
#
# Copyright (c) 2022 Thys de Wet
# SPDX-License-Identifier: MIT
#

if BOARD_CHOCKEA_LEFT

	config ZMK_KEYBOARD_NAME
	default "Chockea"

endif # BOARD_CHOCKEA_LEFT

if BOARD_CHOCKEA_RIGHT

	config ZMK_KEYBOARD_NAME
	default "Chockea rt"

endif # BOARD_CHOCKEA_RIGHT


if BOARD_CHOCKEA_LEFT || BOARD_CHOCKEA_RIGHT

config BOARD
	default "chockea"

config ZMK_SPLIT
	default y

config SPI
    bool
    default y

config BT_CTLR
	default BT

config ZMK_BLE
	default y

config ZMK_USB
	default y

if USB

config USB_NRFX
	default y

config USB_DEVICE_STACK
	default y

endif # USB

config ZMK_DISPLAY
	select LVGL_USE_CONT
	select LVGL_FONT_MONTSERRAT_26
	select LVGL_FONT_MONTSERRAT_20
	select LVGL_FONT_MONTSERRAT_16
	select LVGL_USE_LABEL
	select LVGL_USE_IMG

choice ZMK_DISPLAY_STATUS_SCREEN
	default ZMK_DISPLAY_STATUS_SCREEN_CUSTOM
endchoice

if ZMK_DISPLAY

config SPI
	default y

config IL0323
	bool
	default y

#config DISPLAY_WOB
#	bool "White on Black Display"
#	default n

endif # ZMK_DISPLAY

menuconfig CUSTOM_WIDGET_BATTERY_STATUS
	bool "custom battery status widget"

menuconfig CUSTOM_WIDGET_OUTPUT_STATUS
	bool "custom output status widget"

menuconfig CUSTOM_WIDGET_LAYER_STATUS
	bool "custom layer status widget"


endif # BOARD_CHOCKEA_LEFT || BOARD_CHOCKEA_RIGHT
```
